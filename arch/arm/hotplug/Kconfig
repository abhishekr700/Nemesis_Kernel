## arch/arm/hotplug/Kconfig
```kconfig
config CLUSTER_PLUG
        bool "Enable cluster-plug cpu hotplug driver"
        default n
        help
          CPU hotplug driver designed for ARM big.LITTLE systems where
          both the big and little CPUs are of the same type. On these
          systems, it preferable to normall use the big cluster, and
          only activate the little cluster for highly parallel loads.
          This hotplug implementation always keeps the big cluster
          online, and only activates the little cluster for heavy
          parallel loads.

config INTELLI_PLUG
        bool "Enable intelli-plug cpu hotplug driver"
        default n
        help
          Generic Intelli-plug cpu hotplug driver for ARM SOCs

config ZEN_DECISION
	bool "Zen Decision: MSM Userspace Handler"
	depends on SMP && FB
	default n
	help
	  MSM/Qcomm devices have multiple userspace applications that handle
	  CPU hotplugging and frequency operations.

	  ZenDecision is a "handler" to account for behavior caused by
	  disabling some of these services.

	  For example, If MPDecision is disabled and MSM-Thermal_Engine is 
	  enabled in the userspace. Situations where CPUs go offline but never
	  come back online occur. ZenDecision handles the situation of CPUs
	  never coming online when they are supposed.
  
	  ZenDecision ensures all CPUs are online when they are supposed to be by:
	  - Enable all CPUs when screen comes on after wake_wait_delay
	  - Ignore all CPU_UP operations when battery level is <= 15% to respect
	    decisions of MSMThermal.

	  Userspace tunables for ZenDecision (/sys/kernel/zen_decision):
	  - enabled (0 or 1): Enable or disable the driver.
	  - wake_wait_time (0-60000): How long to wait before executing CPU_UP work.
	  - bat_threshold_ignore (0-100, 0=disabled): Don't do any CPU_UP work up to
	     this battery charge level.

	  WARNING: ZenDecision is not a direct replacement for any of the MSM userspace
	  services. It is simply designed to "handle" specific behaviors that are caused
	  by disabling these services.

	  If unsure, say N.

config MAKO_HOTPLUG
    bool "Mako Hotplug"
    default n
    help
      Mako Hotplug: A custom hotplug by fransico franco

config MSM_SLEEPER
    bool "CPU hotplug driver"
 	default y
 	help
	  CPU hotplug driver

config ASMP
    bool "Multi-core automatic hotplug support"
    depends on SMP
    default n
    help
      Automatically hotplugs the multiple cpu cores on and off
      based on cpu load and suspend state
```
